## config/boards/shields/guardian_remote/Kconfig.defconfig
```kconfig
if SHIELD_GUARDIAN_REMOTE

config ZMK_KEYBOARD_NAME
    default "guardian_remote"

endif
```

## config/boards/shields/guardian_remote/Kconfig.shield
```kconfig
config SHIELD_GUARDIAN_REMOTE
    def_bool $(shields_list_contains,guardian_remote)
```
